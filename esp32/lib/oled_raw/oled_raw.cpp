#include "oled_raw.h"
#include <Wire.h>

#ifndef OLED_SDA
#define OLED_SDA 17
#endif
#ifndef OLED_SCL
#define OLED_SCL 18
#endif
#ifndef OLED_RST
#define OLED_RST 21
#endif
#ifndef OLED_VEXT
#define OLED_VEXT 36               /* ACTIVE LOW on Heltec */
#endif
#define OLED_ADDR 0x3C

/* ---------- 5x7 font (ASCII 32..127), classic public-domain table ---------- */
static const uint8_t font5x7[] PROGMEM = {
    0x00,0x00,0x00,0x00,0x00, 0x00,0x00,0x5F,0x00,0x00, 0x00,0x07,0x00,0x07,0x00,
    0x14,0x7F,0x14,0x7F,0x14, 0x24,0x2A,0x7F,0x2A,0x12, 0x23,0x13,0x08,0x64,0x62,
    0x36,0x49,0x55,0x22,0x50, 0x00,0x05,0x03,0x00,0x00, 0x00,0x1C,0x22,0x41,0x00,
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    0x00,0x41,0x36,0x08,0x00, 0x08,0x08,0x2A,0x1C,0x08, 0x08,0x1C,0x2A,0x08,0x08,
};

uint8_t OledRaw::cmd(uint8_t c) {
    Wire.beginTransmission(OLED_ADDR);
    Wire.write(0x00);                /* Co=0 D/C=0: command */
    Wire.write(c);
    return Wire.endTransmission();
}

bool OledRaw::cmds(const uint8_t *c, size_t n, const char *what) {
    for (size_t i = 0; i < n; i++) {
        uint8_t err = cmd(c[i]);
        if (err != 0) {
            Serial.printf("[oled] cmd 0x%02X (%s) FAILED i2c err=%u\n",
                          c[i], what, err);
            return false;
        }
    }
    return true;
}

bool OledRaw::panelInit() {
    /* Standard SSD1306/SSD1315 128x64 init (same values Heltec ships). */
    static const uint8_t seq[] = {
        0xAE,             /* display off */
        0xD5, 0x80,       /* clock divide */
        0xA8, 0x3F,       /* multiplex 64 */
        0xD3, 0x00,       /* display offset 0 */
        0x40,             /* start line 0 */
        0x8D, 0x14,       /* charge pump ON */
        0x20, 0x00,       /* horizontal addressing mode */
        0xA1,             /* segment remap (flip X) */
        0xC8,             /* COM scan dec (flip Y) */
        0xDA, 0x12,       /* COM pins: alt, no remap */
        0x81, 0xCF,       /* contrast */
        0xD9, 0xF1,       /* precharge */
        0xDB, 0x40,       /* VCOMH */
        0xA4,             /* resume from RAM */
        0xA6,             /* normal (not inverted) */
        0xAF,             /* display ON */
    };
    return cmds(seq, sizeof(seq), "init");
}

bool OledRaw::begin() {
    /* Vext powers the OLED — ACTIVE LOW on Heltec. */
    pinMode(OLED_VEXT, OUTPUT);
    digitalWrite(OLED_VEXT, LOW);
    if (!_init) {
        delay(100);                        /* Vext + charge pump settle */
        Wire.begin(OLED_SDA, OLED_SCL);
        Wire.setClock(400000);
        pinMode(OLED_RST, OUTPUT);
        digitalWrite(OLED_RST, LOW);  delay(10);
        digitalWrite(OLED_RST, HIGH); delay(50);
    }
    /* Full init every time: the SSD1315 drops its charge pump on
       display-off and stays dark (while still ACKing) without it. */
    if (!panelInit()) return false;
    _init = true;
    return true;
}

void OledRaw::sleep() {
    if (_init) cmd(0xAE);              /* display OFF (RAM retained) */
}

void OledRaw::clear() { memset(_fb, 0, sizeof(_fb)); }

void OledRaw::text(int x, int page, const char *s) {
    if (page < 0 || page > 7) return;
    for (; *s && x <= 122; s++, x += 6) {
        char c = *s;
        if (c < 32 || c > 126) c = '?';
        const uint8_t *g = &font5x7[(c - 32) * 5];
        for (int i = 0; i < 5; i++)
            _fb[page * 128 + x + i] = pgm_read_byte(&g[i]);
    }
}

bool OledRaw::flush() {
    static const uint8_t win[] = { 0x21, 0, 127,    /* column 0..127 */
                                   0x22, 0, 7 };    /* page 0..7 */
    if (!cmds(win, sizeof(win), "window")) return false;
    for (int i = 0; i < 128 * 8; i += 16) {
        Wire.beginTransmission(OLED_ADDR);
        Wire.write(0x40);            /* Co=0 D/C=1: data */
        Wire.write(&_fb[i], 16);
        uint8_t err = Wire.endTransmission();
        if (err != 0) {
            Serial.printf("[oled] data chunk @%d FAILED i2c err=%u\n", i, err);
            return false;
        }
    }
    return true;
}
